#include <avr/pgmspace.h>
#include <Tlc5940.h>

/**
 * A couple of tables generated by an external program. Here's that program's source:
 *
#include <stdio.h>
#define _USE_MATH_DEFINES
#include <math.h>

int main(int argc, char *argv[])
{
	for (int i = 0; i < 256; i++) {
		if ((i & 15) == 0)
			printf("\n");
		double x = (double)i / 255.0;
		double y = pow(x, 3.5);
		int value = int(y * 4095.0);
		printf("%4i, ", value);
	}

	printf("\n\n");

	for (int i = 0; i < 256; i++) {
		if ((i & 15) == 0)
			printf("\n");
		double x = (double)i / 256.0 * M_PI * 2.0;
		double y = sin(x);
		int value = int(y * 127.5 + 127.5);
		printf("%3i, ", value);
	}

	printf("\n\n");

	for (int y = 0; y < 16; y++) {
		printf("  { ");
		for (int x = 0; x < 16; x++) {
			double dist = sqrt((double)(x*x + y*y) / 450.0);
			int value = int(dist * 255.0);
			printf("%3i, ", value);
		}
		printf(" },\n");
	}

	getchar();

	return 0;
}
*/

/**
 * Gamma correction -- maps 8bit grayscale values to gamma-corrected 12bit PWM values.
 * My display looks nice with a gamma of 3.5, so that's what's in the table.
 */
PROGMEM word gamma[2][256] = {
{
   0,    0,    0,    0,    0,    0,    0,    0,    0,    0,    0,    0,    0,    0,    0,    0,
   0,    0,    0,    0,    0,    0,    0,    0,    1,    1,    1,    1,    1,    2,    2,    2,
   2,    3,    3,    3,    4,    4,    5,    5,    6,    6,    7,    8,    8,    9,   10,   11,
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3312, 3360, 3409, 3459, 3509, 3559, 3611, 3662, 3714, 3767, 3820, 3874, 3928, 3983, 4039, 4095,},

/* alternate gamma table giving a blob-like effect -- black, short gamma ramp, full on */
{
   0,    0,    0,    0,    0,    0,    0,    0,    0,    0,    0,    0,    0,    0,    0,    0,
   0,    0,    0,    0,    0,    0,    0,    0,    0,    0,    0,    0,    0,    0,    0,    0,
   0,    0,    0,    0,    0,    0,    0,    0,    0,    0,    0,    0,    0,    0,    0,    0,
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4095, 4095, 4095, 4095, 4095, 4095, 4095, 4095, 4095, 4095, 4095, 4095, 4095, 4095, 4095, 4095,}
};

/**
 * A sine table mapping [0, 255] to [0, 255] with the DC value at 127.5
 */
PROGMEM byte sine[256] = {
127, 130, 133, 136, 139, 143, 146, 149, 152, 155, 158, 161, 164, 167, 170, 173,
176, 179, 182, 184, 187, 190, 193, 195, 198, 200, 203, 205, 208, 210, 213, 215,
217, 219, 221, 224, 226, 228, 229, 231, 233, 235, 236, 238, 239, 241, 242, 244,
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 78,  81,  84,  87,  90,  93,  96,  99, 102, 105, 108, 111, 115, 118, 121, 124, };

/**
 * Distance of a x/y coordinate from 0/0, normalized so that the max distance
 * (display diagonal) is 255
 */
PROGMEM byte dist[16][16] = {
  {   0,  12,  24,  36,  48,  60,  72,  84,  96, 108, 120, 132, 144, 156, 168, 180,  },
  {  12,  17,  26,  38,  49,  61,  73,  85,  96, 108, 120, 132, 144, 156, 168, 180,  },
  {  24,  26,  34,  43,  53,  64,  76,  87,  99, 110, 122, 134, 146, 158, 170, 181,  },
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  { 180, 180, 181, 183, 186, 190, 194, 198, 204, 210, 216, 223, 230, 238, 246, 255,  } };

typedef byte framebuffer_t[16][16];
framebuffer_t framebuffers[2];
volatile byte currentColumn = 0;
volatile byte currentBuffer = 0;
volatile byte nextBuffer = 0;
volatile byte currentGamma = 0;

/* the input pin of the shift register */
const int SHIFTPIN = 6;

/* the buttons and LEDs on board */
const int BTN1 = 14;
const int LED1 = 15;
const int BTN2 = 16;
const int BTN3 = 17;
const int LED2 = 18;
const int BTN4 = 19;

PROGMEM byte roworder[16] = { 2, 0, 3, 1, 7, 5, 4, 6, 8, 10, 9, 11, 15, 13, 12, 14 };

/**
 * This code piggybacks on top of the TLC library and uses the XLAT signal as clock
 * for the shift registers that scan across columns (which is a pretty natural place
 * as the shift occurs during a BLANK period this way).
 * Every 16 columns, it shifts a one into the start of the register to restart the
 * scanning process.
 */
volatile void xlat_callback()
{
  if (currentColumn == 0) {
    digitalWrite(SHIFTPIN, LOW);
    currentBuffer = nextBuffer;
  } else {
    digitalWrite(SHIFTPIN, HIGH);
  }
  
  for (int i = 0; i < 16; i++)
    Tlc.set(i ^ 1, pgm_read_word(gamma[currentGamma] + framebuffers[currentBuffer][pgm_read_byte(roworder + currentColumn)][i]));
  Tlc.update();

  currentColumn = (currentColumn + 1) & 15;
}

inline framebuffer_t &getNextBuffer()
{
  return framebuffers[currentBuffer ^ 1];
}

void swap()
{
  nextBuffer = currentBuffer ^ 1;
}

void waitForUpdate()
{
  while (currentBuffer != nextBuffer);
}

void setup()
{
  memset(framebuffers, 0, sizeof(framebuffers));
  digitalWrite(BTN1, HIGH);
  digitalWrite(BTN2, HIGH);
  digitalWrite(BTN3, HIGH);
  digitalWrite(BTN4, HIGH);
  digitalWrite(LED1, LOW);
  digitalWrite(LED2, LOW);
  digitalWrite(SHIFTPIN, HIGH);
  pinMode(BTN1, INPUT);
  pinMode(BTN2, INPUT);
  pinMode(BTN3, INPUT);
  pinMode(BTN4, INPUT);
  pinMode(LED1, OUTPUT);
  pinMode(LED2, OUTPUT);
  pinMode(SHIFTPIN, OUTPUT);
  Tlc.init();
  Tlc.setAllDC(0x1F);
  tlc_onUpdateFinished = xlat_callback;
  xlat_callback();
}

word frame = 0;

/* A couple of helper defines for reading out the tables */
#define sin(x) pgm_read_byte(sine + ((x) & 255))
#define cos(x) sin((x) + 128)
#define distance_tl(x, y) pgm_read_byte(&dist[x][y])
#define mid2tl(x) (((((x) < 8) ? (7 - (x)) : ((x) - 8)) << 1) + 1)
#define distance_mid(x, y) distance_tl(mid2tl(x), mid2tl(y))

int effectmask = 15;

/**
 * This loop implements a nice plasma effect by overlaying four sine functions --
 * one in the x direction, one in the y direction and two radial ones with different midpoints.
 */
void loop()
{
  const byte bitcount[16] = { 0, 0, 0, 1, 0, 1, 1, 2, 0, 1, 1, 2, 1, 2, 2, 2 };
  
  framebuffer_t &fb = getNextBuffer();
//  digitalWrite(LED2, HIGH);
  for (byte y = 0; y < 16; y++)
    for (byte x = 0; x < 16; x++) {
      word accu = 0;
      if (effectmask & 1)
        accu += sin(((distance_tl(x, y) * 3) >> 1) - ((frame * 17) >> 3));
      if (effectmask & 2)
        accu += sin((x * 11) + (frame >> 1) + ((sin(frame >> 1) - 64) * 2) + ((sin((frame * 7) >> 2) * 5) >> 3));
      if (effectmask & 4)
        accu += sin(y * 17 + frame * 2 + sin(frame) - 128);
      if (effectmask & 8)
        accu += sin((distance_mid(x, y)) + ((frame * 7) >> 2));
      
      fb[x][y] = accu >> bitcount[effectmask];
    }
//  digitalWrite(LED2, LOW);
  swap();
  frame++;
  waitForUpdate();

//  digitalWrite(LED1, frame & 1);

  {  
    /* Switch between low and high contrast */
    static int curButton = HIGH, lastButton = HIGH;
    curButton = digitalRead(BTN1);
    if (curButton != lastButton) {
      if (curButton == LOW) /* button pulls to GND */
        currentGamma ^= 1;
      lastButton = curButton;
    }
  }
  {
    /* Switch between low and high brightness */
    static int brightness = 1;
    static int curButton = HIGH, lastButton = HIGH;
    curButton = digitalRead(BTN3);
    if (curButton != lastButton) {
      if (curButton == LOW) { /* button pulls to GND */
        brightness++;
        brightness &= 3;
        Tlc.setAllDC(0x0F + (brightness << 4));
        xlat_callback();
      }
      lastButton = curButton;
    }
  }
  {
    /* Cycle effects */
    static int curButton = HIGH, lastButton = HIGH;
    curButton = digitalRead(BTN2);
    if (curButton != lastButton) {
      if (curButton == LOW) /* button pulls to GND */
        effectmask++;
      if (effectmask > 15)
        effectmask = 1;
      lastButton = curButton;
    }
  }
}

